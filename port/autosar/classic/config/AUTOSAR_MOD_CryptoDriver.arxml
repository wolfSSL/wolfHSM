AUTOSAR XML (schema 00050)
package /wolfHSM/EcucModuleDefs
  module definition Crypto [0..1]: refined-module-def=Crypto  # wolfHSM Crypto Driver, AUTOSAR R22-11
    container CryptoGeneral  # Driver-wide configuration.
      integer CryptoDriverObjectCount: 1..255, default-value=1  # Number of Crypto Driver Objects (CRYPTO_DRIVER_OBJECT_COUNT).
      integer CryptoMaxAsyncJobs: 1..32, default-value=4  # Maximum queued async jobs per driver object (CRYPTO_MAX_ASYNC_JOBS).
      integer CryptoVendorId: 0..65535, default-value=0  # AUTOSAR-registered vendor identifier (CRYPTO_VENDOR_ID).
      boolean CryptoDevErrorDetect: default-value=true  # Enable DET error reporting (CRYPTO_DEV_ERROR_DETECT).
    container CryptoDriverObject [1..255]  # One Crypto Driver Object per wolfHSM client context.
      integer CryptoDriverObjectId: 0..254  # Object identifier passed to Crypto_ProcessJob.
      integer CryptoQueueSize: 1..255, default-value=8  # CSM-facing queue depth for this object.
    container CryptoKey [0..*]  # AUTOSAR Crypto Key descriptor, drives the wolfHSM Crypto_KeyDescriptorTable.
      integer CryptoKeyId: 0..255  # cryptoKeyId used in Crypto_KeyType.
      enumeration CryptoKeyFamily: {AES, RSA, ECCNIST, ED25519, X25519, HKDF, CMAC_KDF}  # Algorithm family, maps to Crypto_AlgorithmFamilyType.
      integer CryptoKeyLengthBits: 1..16384  # Key length in bits.
      integer CryptoEccCurveId [0..1]: 0..255  # wolfCrypt curve id (ECC_SECP*). Used when family=ECCNIST.
